## drivers/misc/mediatek/connectivity/Kconfig
```kconfig
# SPDX-License-Identifier: GPL-2.0
config MTK_COMBO
bool "MediaTek MT6895 connectivity support"
help
  Enable the downstream MediaTek connectivity stack for MT6895
  (CONNAC2X2 SOC7_0) on the xaga mainline port.

config MTK_COMBO_CHIP_CONSYS_6895
bool "MT6895 Consys support"
depends on MTK_COMBO
default y

config MTK_COMBO_WIFI
bool "MT6895 Wi-Fi support"
depends on MTK_COMBO
default y

config MTK_CONNSYS_DEDICATED_LOG_PATH
bool "MTK dedicated connsys log path"
depends on MTK_COMBO
default y
```

## drivers/misc/mediatek/eccci/Kconfig
```kconfig
# SPDX-License-Identifier: GPL-2.0
menuconfig MTK_CCCI_MAINLINE
	bool "MTK CCCI cellular modem driver (mainline port, built-in)"
	depends on ARCH_MEDIATEK
	depends on NET
	help
	  Evolved CCCI driver + ccmni ported from the Xiaomi MT6895 vendor
	  kernel for mainline MT6895 (xaga/pearl). Probes the "mediatek,mddriver"
	  DT node and brings up the cellular modem control/data channels.
	  Built-in: probes automatically at boot, no module loading needed.

config MTK_CCCI_MAINLINE_DATAPATH_HIF
	bool "MT6895 CCCI data-path HIFs (CLDMA + DPMAIF) built-in"
	depends on MTK_CCCI_MAINLINE
	default n
	help
	  CLDMA and DPMAIF carry the MD data path.  The proven xaga/pearl
	  bring-up loads only the CCIF HIF: the modem reaches the handshake
	  and exchanges the runtime data over CCIF, and the CLDMA/DPMAIF
	  probes touch hardware this port has not validated yet.  Say N to
	  keep them out of the built-in image; build them as modules
	  (CONFIG_MTK_CCCI_MAINLINE_DATAPATH_HIF=m) for data-path work.
```

## drivers/misc/mediatek/mtk-interconnect/Kconfig
```kconfig
# SPDX-License-Identifier: GPL-2.0-only

config INTERCONNECT_MTK_EXTENSION
	tristate "MediaTek network-on-chip interconnect extension driver"
	depends on INTERCONNECT_MTK
	help
	  MediaTek's out-of-tree interconnect extension framework, used by the
	  multimedia QoS (mmqos) provider and by the multimedia consumers
	  (camera/ISP, display, codecs) to describe per-port bandwidth paths
	  with the "mtk-interconnect-cells" bindings.
```

## drivers/misc/mediatek/scp/Kconfig
```kconfig
# SPDX-License-Identifier: GPL-2.0
config MTK_TINYSYS_SCP_SUPPORT
	tristate "module bring-up"
	bool "MediaTek SCP coprocessor (RV) support"
	help
	  SCP is a MediaTek in-house coprocessor. On qqcandy the sensor hub
	  (all physical sensor drivers, step counting, fusion) runs as SCP
	  firmware preloaded by the bootloader; this driver verifies the
	  image in SRAM, releases the core and provides the IPI channel.
	  Ported from OnePlusOSS android_kernel_5.10_oneplus_mt6895
	  (oneplus/mt6895_v_15.0.0_ace_race), scp/rv variant.

config MTK_TINYSYS_SCP_LOGGER_SUPPORT
	tristate "module bring-up"
	bool "SCP logger support"
	depends on MTK_TINYSYS_SCP_SUPPORT
	default y
	help
	  SCP firmware log capture. Keep enabled for bring-up diagnostics.

config MTK_TINYSYS_SCP_DEBUG_SUPPORT
	tristate "module bring-up"
	bool "SCP debug support (proc nodes)"
	default y
	help
	  Debug interfaces for the SCP driver. Keep enabled for bring-up.
```

## drivers/misc/mediatek/sensor/2.0/Kconfig
```kconfig
# SPDX-License-Identifier: GPL-2.0
config MTK_SENSOR_SUPPORT
	bool "MediaTek sensor 2.0 core (hf_manager)"
	help
	  The sensor 2.0 core: /dev/hf_manager character device that the
	  sensor HAL talks to. Ported from OnePlusOSS 5.10 ace_race,
	  drivers/misc/mediatek/sensor/2.0/core.

config MTK_SENSORHUB
	bool "MediaTek sensorhub over SCP IPI"
	depends on MTK_SENSOR_SUPPORT && MTK_TINYSYS_SCP_SUPPORT
	help
	  The sensorhub backend: talks to the SCP sensor firmware over
	  IPI (SENSOR_CTRL / SENSOR_NOTIFY pins) and shared memory,
	  retrieves the runtime sensor list and forwards samples to
	  hf_manager. Ported from OnePlusOSS 5.10 ace_race,
	  drivers/misc/mediatek/sensor/2.0/sensorhub.

config MTK_HF_IIO
	tristate "MediaTek SCP sensors as standard Linux IIO devices"
	depends on MTK_SENSOR_SUPPORT
	help
	  Exposes the SCP-attached sensors (accelerometer, gyroscope,
	  magnetometer, ambient light, proximity) as standard IIO devices so
	  that plain-Linux consumers such as iio-sensor-proxy, libiio and the
	  KDE/GNOME desktops work unmodified.

	  The MTK stack already provides everything behind /dev/hf_manager, but
	  its only stock consumer is the Android HIDL sensor HAL, which cannot
	  run on a systemd rootfs (no binder/hwbinder).  This driver is the
	  native replacement: it uses hf_manager's exported kernel client API
	  and publishes accel/gyro/magn/als/prox under /sys/bus/iio/devices/.

	  Say M to build it as a module (usual choice) or Y to build it in.
```

## drivers/misc/mediatek/sensor/2.0/sensorhub/Kconfig
```kconfig
# SPDX-License-Identifier: GPL-2.0
config MTK_SENSORHUB
	tristate "MediaTek SCP sensor-hub transport and IIO frontend"
	depends on MTK_TINYSYS_SCP_SUPPORT
	depends on IIO
	help
	  Support for sensors owned by the MediaTek SCP sensor-hub firmware.
	  The SCP drives the physical ALS/IMU and streams samples over IPI plus
	  shared-memory rings; this option provides the transport, firmware
	  sensor enumeration and time synchronisation, and publishes ambient
	  light and acceleration as standard IIO devices.

	  Say Y here if you want SCP-backed sensors on a MediaTek SoC, for
	  example ambient-light based brightness or accelerometer-based screen
	  rotation.

	  To compile this driver as a module, choose M here. The module will be
	  called sensorhub.
```

## drivers/misc/mediatek/sim_detect/Kconfig
```kconfig
# SPDX-License-Identifier: GPL-2.0

config SIM_DETECT
	tristate "Oplus SIM card detect"
	depends on OF_GPIO
	help
	  Expose the board's physical SIM card detect GPIO through
	  /proc/sim_detect, as used by Oplus userspace.
```
