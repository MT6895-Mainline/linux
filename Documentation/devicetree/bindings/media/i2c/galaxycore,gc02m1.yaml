## Documentation/devicetree/bindings/media/mediatek,mt6895-seninf.yaml
```yaml
# SPDX-License-Identifier: (GPL-2.0-only OR BSD-2-Clause)
%YAML 1.2
---
$id: http://devicetree.org/schemas/media/mediatek,mt6895-seninf.yaml#
$schema: http://devicetree.org/meta-schemas/core.yaml#

title: MediaTek MT6895 camera sensor interface (SENINF)

maintainers:
  - Akisaira <akisaira@outlook.com>

description:
  The SENINF receives MIPI CSI-2 data from camera sensors on ten interfaces.
  Each of the five CSI ports (CSI0 to CSI4) feeds either interface 2N as a
  whole port with up to four data lanes, or interfaces 2N and 2N + 1 as two
  halves with up to two data lanes each. The SENINF filters each stream by
  virtual channel and data type into one of its muxes and routes the mux
  through one of its 23 camera multiplexer (CAM_MUX) outputs to the camera
  engine wired to that output, such as a CAMSV raw capture engine. The analog
  receivers of the CSI ports are separate PHY devices.

properties:
  compatible:
    const: mediatek,mt6895-seninf

  reg:
    maxItems: 1

  interrupts:
    maxItems: 1

  clocks:
    minItems: 6
    items:
      - description: CAM_MAIN SENINF gate
      - description: SENINF top clock
      - description: SENINF1 top clock
      - description: SENINF2 top clock
      - description: SENINF3 top clock
      - description: SENINF4 top clock
      - description: Camera test model timing clock

  clock-names:
    minItems: 6
    items:
      - const: seninf
      - const: top-seninf
      - const: top-seninf1
      - const: top-seninf2
      - const: top-seninf3
      - const: top-seninf4
      - const: top-camtm

  power-domains:
    items:
      - description: ISP_MAIN power domain
      - description: CAM_MAIN power domain

  power-domain-names:
    items:
      - const: isp
      - const: cam

  phys:
    minItems: 1
    maxItems: 10
    description: Receivers of the CSI ports that the used interfaces connect to

  phy-names:
    minItems: 1
    maxItems: 10
    items:
      enum: [ csi0, csi1, csi2, csi3, csi4, csi0b, csi1b, csi2b, csi3b, csi4b ]
    description:
      csiN is CSI port N as a whole or its half A, csiNb is half B of port N.

  ports:
    $ref: /schemas/graph.yaml#/properties/ports

    patternProperties:
      "^port@[02468]$":
        $ref: /schemas/graph.yaml#/$defs/port-base
        unevaluatedProperties: false
        description:
          Interface N, which receives CSI port N / 2 as a whole or its half A.

        properties:
          endpoint:
            $ref: video-interfaces.yaml#
            unevaluatedProperties: false

            properties:
              bus-type:
                const: 4

              data-lanes:
                minItems: 1
                items:
                  - const: 1
                  - const: 2
                  - const: 3
                  - const: 4

              mediatek,hs-trail-ps:
                description:
                  T_HS-TRAIL of the transmitter on this link in picoseconds,
                  the time for which it drives the flipped last data bit after
                  the last payload bit of a high-speed burst. The receiver
                  derives its HS trail timing from it. The value must meet the
                  D-PHY minimum at the lane rate of the link. Without it the
                  receiver assumes the D-PHY default for the lane rate.
                minimum: 60000
                maximum: 1000000

            required:
              - data-lanes

      "^port@[13579]$":
        $ref: /schemas/graph.yaml#/$defs/port-base
        unevaluatedProperties: false
        description:
          Interface N, which receives half B of CSI port (N - 1) / 2.

        properties:
          endpoint:
            $ref: video-interfaces.yaml#
            unevaluatedProperties: false

            properties:
              bus-type:
                const: 4

              data-lanes:
                minItems: 1
                items:
                  - const: 1
                  - const: 2

              mediatek,hs-trail-ps:
                description:
                  T_HS-TRAIL of the transmitter on this link in picoseconds,
                  the time for which it drives the flipped last data bit after
                  the last payload bit of a high-speed burst. The receiver
                  derives its HS trail timing from it. The value must meet the
                  D-PHY minimum at the lane rate of the link. Without it the
                  receiver assumes the D-PHY default for the lane rate.
                minimum: 60000
                maximum: 1000000

            required:
              - data-lanes

      "^port@([a-f]|1[0-9a-f]|20)$":
        $ref: /schemas/graph.yaml#/properties/port
        description:
          Output of CAM_MUX N - 10 to the camera engine wired to it, for
          example CAMSV0 on CAM_MUX 3 (port@d).

required:
  - compatible
  - reg
  - interrupts
  - clocks
  - clock-names
  - power-domains
  - power-domain-names
  - ports

additionalProperties: false

examples:
  - |
    #include <dt-bindings/clock/mt6895-clk.h>
    #include <dt-bindings/interrupt-controller/arm-gic.h>
    #include <dt-bindings/interrupt-controller/irq.h>
    #include <dt-bindings/phy/phy.h>
    #include <dt-bindings/power/mt6895-power.h>

    seninf@1a010000 {
        compatible = "mediatek,mt6895-seninf";
        reg = <0x1a010000 0x20000>;
        interrupts = <GIC_SPI 444 IRQ_TYPE_LEVEL_HIGH>;
        clocks = <&cam_main_r1a_clk CLK_CAM_MAIN_SENINF_CON>,
                 <&topckgen CLK_TOP_SENINF_SEL>,
                 <&topckgen CLK_TOP_SENINF1_SEL>,
                 <&topckgen CLK_TOP_SENINF2_SEL>,
                 <&topckgen CLK_TOP_SENINF3_SEL>,
                 <&topckgen CLK_TOP_SENINF4_SEL>,
                 <&topckgen CLK_TOP_CAMTM_SEL>;
        clock-names = "seninf", "top-seninf", "top-seninf1", "top-seninf2",
                      "top-seninf3", "top-seninf4", "top-camtm";
        power-domains = <&spm MT6895_POWER_DOMAIN_ISP_MAIN>,
                        <&spm MT6895_POWER_DOMAIN_CAM_MAIN>;
        power-domain-names = "isp", "cam";
        phys = <&mipi_csi0_rx PHY_TYPE_DPHY>, <&mipi_csi1_rx PHY_TYPE_DPHY>,
               <&mipi_csi2_rx PHY_TYPE_DPHY>, <&mipi_csi3_rx PHY_TYPE_DPHY>;
        phy-names = "csi0", "csi1", "csi2", "csi3";

        ports {
            #address-cells = <1>;
            #size-cells = <0>;

            port@0 {
                reg = <0>;

                endpoint {
                    data-lanes = <1 2 3 4>;
                    mediatek,hs-trail-ps = <69000>;
                    remote-endpoint = <&front_camera_out>;
                };
            };

            port@2 {
                reg = <2>;

                endpoint {
                    data-lanes = <1 2 3 4>;
                    mediatek,hs-trail-ps = <78000>;
                    remote-endpoint = <&ultrawide_camera_out>;
                };
            };

            port@4 {
                reg = <4>;

                endpoint {
                    data-lanes = <1 2 3 4>;
                    mediatek,hs-trail-ps = <68000>;
                    remote-endpoint = <&main_camera_out>;
                };
            };

            port@6 {
                reg = <6>;

                endpoint {
                    data-lanes = <1>;
                    mediatek,hs-trail-ps = <92000>;
                    remote-endpoint = <&macro_camera_out>;
                };
            };

            port@d {
                reg = <13>;

                endpoint {
                    remote-endpoint = <&camsv0_in>;
                };
            };
        };
    };
...
```

## Documentation/devicetree/bindings/media/mediatek,mt6895-vcodec-dec.yaml
```yaml
# SPDX-License-Identifier: (GPL-2.0-only OR BSD-2-Clause)
%YAML 1.2
---
$id: http://devicetree.org/schemas/media/mediatek,mt6895-vcodec-dec.yaml#
$schema: http://devicetree.org/meta-schemas/core.yaml#

title: MediaTek MT6895 VCP Video Decoder

maintainers:
  - Silvia <2824799@users.noreply.github.com>

description: |
  The VCP firmware controls the latency and core decoding engines, using
  independent bitstream, decoded picture and unified buffer engine (UBE)
  DMA address spaces. LARB4 and LARB5 supply the memory fabric. The VCP
  sends frame resource requests independently of bitstream commands.

properties:
  compatible:
    const: mediatek,mt6895-vcodec-dec

  reg:
    items:
      - description: Decoder configuration
      - description: Core variable length decoder
      - description: Motion compensation
      - description: Motion vector engine
      - description: Core miscellaneous registers
      - description: Latency miscellaneous registers
      - description: Latency variable length decoder
      - description: Racing control

  reg-names:
    items:
      - const: base
      - const: vld
      - const: mc
      - const: mv
      - const: misc
      - const: lat-misc
      - const: lat-vld
      - const: racing

  interrupts:
    maxItems: 2

  interrupt-names:
    items:
      - const: core
      - const: lat

  clocks:
    items:
      - description: Decoder SoC gate
      - description: Latency gate
      - description: Decoder core gate

  clock-names:
    items:
      - const: soc
      - const: lat
      - const: core

  operating-points-v2:
    maxItems: 1

  dvfsrc-vcore-supply:
    description: Shared multimedia VCORE voltage and clock policy provider.

  power-domains:
    items:
      - description: Decoder SoC power domain
      - description: Decoder core power domain

  iommus:
    minItems: 10
    maxItems: 10
    description: Normal domain zero ports of LARB4 used for hardware buffers.

  mediatek,vcp:
    $ref: /schemas/types.yaml#/definitions/phandle
    description: Remote processor running the VCP decoder firmware.

  mediatek,vcp-vdec-dma:
    $ref: /schemas/types.yaml#/definitions/phandle
    description: Decoder bitstream DMA device in multimedia domain five.

  mediatek,vdec-ube-dma:
    $ref: /schemas/types.yaml#/definitions/phandle
    description: UBE DMA device in display domain one.

  mediatek,larbs:
    $ref: /schemas/types.yaml#/definitions/phandle-array
    items:
      - items:
          - description: Decoder SoC LARB4
      - items:
          - description: Decoder core LARB5
    description: Decoder SMI memory fabric suppliers.

required:
  - compatible
  - reg
  - reg-names
  - interrupts
  - interrupt-names
  - clocks
  - clock-names
  - power-domains
  - iommus
  - mediatek,vcp
  - mediatek,vcp-vdec-dma
  - mediatek,vdec-ube-dma
  - mediatek,larbs

additionalProperties: false
```

## Documentation/devicetree/bindings/media/mediatek,mt6895-vcodec-enc.yaml
```yaml
# SPDX-License-Identifier: (GPL-2.0-only OR BSD-2-Clause)
%YAML 1.2
---
$id: http://devicetree.org/schemas/media/mediatek,mt6895-vcodec-enc.yaml#
$schema: http://devicetree.org/meta-schemas/core.yaml#

title: MediaTek MT6895 Video Encoder

maintainers:
  - Silvia <2824799@users.noreply.github.com>

description: |
  Two encoder cores controlled by the MT6895 VCP firmware. Each core has
  its own register window, interrupt, clock gate, power domain and SMI
  LARB. Both cores share the VENC clock selector and the emergency break
  control in the first register window. This hardware uses the handset
  VCP protocol rather than the Chromebook SCP encoder protocol.

properties:
  compatible:
    const: mediatek,mt6895-vcodec-enc

  reg:
    items:
      - description: Encoder core 0 and shared break control
      - description: Encoder core 1

  reg-names:
    items:
      - const: VENC_SYS
      - const: VENC_C1_SYS

  interrupts:
    maxItems: 2

  clocks:
    items:
      - description: Encoder core 0 clock gate
      - description: Encoder core 1 clock gate

  clock-names:
    items:
      - const: venc_sel
      - const: venc_c1_sel

  power-domains:
    items:
      - description: Encoder core 0 power domain
      - description: Encoder core 1 power domain

  iommus:
    minItems: 62
    maxItems: 62
    description: |
      All ports 0 through 30 of LARB7 followed by all ports 0 through 30
      of LARB8, routed through multimedia IOMMU table 0, normal domain 0.

  mediatek,vcp:
    $ref: /schemas/types.yaml#/definitions/phandle
    description: VCP which runs the encoder firmware.

  mediatek,larbs:
    $ref: /schemas/types.yaml#/definitions/phandle-array
    items:
      - items:
          - description: SMI LARB7 for encoder core 0
      - items:
          - description: SMI LARB8 for encoder core 1
    description: Memory fabric suppliers for the two encoder cores.

required:
  - compatible
  - reg
  - reg-names
  - interrupts
  - clocks
  - clock-names
  - power-domains
  - iommus
  - mediatek,vcp
  - mediatek,larbs

additionalProperties: false
```

## Documentation/devicetree/bindings/media/mediatek,mt6895-vdec-dma.yaml
```yaml
# SPDX-License-Identifier: (GPL-2.0-only OR BSD-2-Clause)
%YAML 1.2
---
$id: http://devicetree.org/schemas/media/mediatek,mt6895-vdec-dma.yaml#
$schema: http://devicetree.org/meta-schemas/core.yaml#

title: MediaTek MT6895 VCP Codec DMA Address Spaces

maintainers:
  - Silvia <2824799@users.noreply.github.com>

description: |
  Auxiliary DMA devices describing the address spaces the VCP firmware and
  its codec engines use. Decoder compressed bitstreams occupy multimedia
  IOMMU domain five, pseudo LARB33 port zero, 0x110000000 through
  0x12fffffff. The decoder's unified buffer engine uses display IOMMU domain
  one, LARB5 port five, 0x20000000 through 0x32bfffff. Encoder bitstreams
  occupy video IOMMU domain six, pseudo LARB33 port one, 0x130000000 through
  0x14fffffff.

properties:
  compatible:
    enum:
      - mediatek,mt6895-vcp-vdec-dma
      - mediatek,mt6895-vcp-venc-dma
      - mediatek,mt6895-vdec-ube-dma

  iommus:
    maxItems: 1

required:
  - compatible
  - iommus

additionalProperties: false
```

## Documentation/devicetree/bindings/phy/mediatek,mt6895-csi-rx.yaml
```yaml
# SPDX-License-Identifier: (GPL-2.0-only OR BSD-2-Clause)
%YAML 1.2
---
$id: http://devicetree.org/schemas/phy/mediatek,mt6895-csi-rx.yaml#
$schema: http://devicetree.org/meta-schemas/core.yaml#

title: MediaTek MT6895 MIPI CSI-2 receiver C/D-PHY

maintainers:
  - Akisaira <akisaira@outlook.com>

description:
  Each CSI port of the MT6895 sensor interface (SENINF) has its own MIPI
  CSI-2 receiver C/D-PHY, version 3.0, in a 16 KiB register block. The block
  holds two analog halves (A and B) of three differential pairs each and a
  D-PHY and a C-PHY digital front end. In D-PHY mode the two halves form one
  receiver with the clock lane on pair L2 of half A and up to four data
  lanes. The PHY is only accessible while the SENINF power domains and clocks
  are enabled; its consumer, the SENINF, keeps them enabled while the PHY is
  powered.

properties:
  compatible:
    const: mediatek,mt6895-csi-rx

  reg:
    maxItems: 1
    description: The register block of one CSI port.

  '#phy-cells':
    const: 1
    description:
      The PHY type requested by the consumer, PHY_TYPE_DPHY or PHY_TYPE_CPHY
      as defined in include/dt-bindings/phy/phy.h.

required:
  - compatible
  - reg
  - '#phy-cells'

additionalProperties: false

examples:
  - |
    phy@11c94000 {
        compatible = "mediatek,mt6895-csi-rx";
        reg = <0x11c94000 0x4000>;
        #phy-cells = <1>;
    };
...
```
