## Documentation/devicetree/bindings/regulator/mediatek,mt6873-dvfsrc-regulator.yaml
```yaml
# SPDX-License-Identifier: (GPL-2.0 OR BSD-2-Clause)
%YAML 1.2
---
$id: http://devicetree.org/schemas/regulator/mediatek,mt6873-dvfsrc-regulator.yaml#
$schema: http://devicetree.org/meta-schemas/core.yaml#

title: MediaTek DVFSRC-controlled Regulators

description:
  The Dynamic Voltage and Frequency Scaling Resource Collector Regulators
  are controlled with votes to the DVFSRC hardware.

maintainers:
  - AngeloGioacchino Del Regno <angelogioacchino.delregno@collabora.com>

properties:
  compatible:
    enum:
      - mediatek,mt6873-dvfsrc-regulator
      - mediatek,mt6893-dvfsrc-regulator
      - mediatek,mt6895-dvfsrc-regulator
      - mediatek,mt8183-dvfsrc-regulator
      - mediatek,mt8192-dvfsrc-regulator
      - mediatek,mt8195-dvfsrc-regulator
      - mediatek,mt8196-dvfsrc-regulator

  clocks:
    minItems: 20
    maxItems: 20
    description: |
      MT6895 multimedia muxes followed by the fixed-rate sources used by
      its VCORE policy. The provider coordinates these clocks with VCORE.

  clock-names:
    items:
      - const: disp0
      - const: disp1
      - const: mminfra
      - const: venc
      - const: vdec
      - const: mdp0
      - const: mdp1
      - const: univpll-d6-d2
      - const: univpll-d5-d2
      - const: mainpll-d5
      - const: univpll-d4
      - const: mainpll-d5-d2
      - const: mainpll-d4-d2
      - const: mmpll-d4
      - const: univpll-d4-d2
      - const: mmpll-d6
      - const: univpll-d6
      - const: tvdpll
      - const: imgpll-d2
      - const: mmpll-d6-d2

  dvfsrc-vcore:
    description: DVFSRC-controlled SoC Vcore regulator
    $ref: regulator.yaml#
    unevaluatedProperties: false

  dvfsrc-vscp:
    description: DVFSRC-controlled System Control Processor regulator
    $ref: regulator.yaml#
    unevaluatedProperties: false

required:
  - compatible

anyOf:
  - required:
      - dvfsrc-vcore
  - required:
      - dvfsrc-vscp

allOf:
  - if:
      properties:
        compatible:
          const: mediatek,mt6895-dvfsrc-regulator
    then:
      required:
        - clocks
        - clock-names
        - dvfsrc-vcore
    else:
      properties:
        clocks: false
        clock-names: false

additionalProperties: false
```

## Documentation/devicetree/bindings/regulator/onnn,fan53870.yaml
```yaml
# SPDX-License-Identifier: GPL-2.0-only OR BSD-2-Clause
%YAML 1.2
---
$id: http://devicetree.org/schemas/regulator/onnn,fan53870.yaml#
$schema: http://devicetree.org/meta-schemas/core.yaml#

title: Onsemi FAN53870 camera PMIC

maintainers:
  - Akisaira <akisaira@outlook.com>

description: |
  The FAN53870 provides seven independently controlled LDO outputs over I2C.
  Only outputs listed under regulators are managed. Outputs must use direct
  I2C enable control rather than the hardware sequencer. Explicit voltage
  constraints are required to avoid relying on factory-default voltages.

properties:
  compatible:
    const: onnn,fan53870

  reg:
    maxItems: 1

  enable-gpios:
    maxItems: 1
    description:
      Optional board-level enable signal required for access to the PMIC.
      Held asserted while the regulator provider is registered. The GPIO
      controller must be non-sleeping because the signal is asserted with
      the I2C bus segment locked to keep the rising edge between transactions.

  vin12-supply:
    description: Input supply for LDO1 and LDO2

  vin34-supply:
    description: Input supply for LDO3 and LDO4

  vin5-supply:
    description: Input supply for LDO5

  vin6-supply:
    description: Input supply for LDO6

  vin7-supply:
    description: Input supply for LDO7

  regulators:
    type: object
    additionalProperties: false

    patternProperties:
      "^ldo[1-7]$":
        type: object
        $ref: regulator.yaml#
        unevaluatedProperties: false
        required:
          - regulator-min-microvolt
          - regulator-max-microvolt

required:
  - compatible
  - reg
  - regulators

additionalProperties: false

examples:
  - |
    i2c {
        #address-cells = <1>;
        #size-cells = <0>;

        regulator@35 {
            compatible = "onnn,fan53870";
            reg = <0x35>;

            regulators {
                ldo5 {
                    regulator-name = "camera-avdd";
                    regulator-min-microvolt = <2804000>;
                    regulator-max-microvolt = <2804000>;
                };
            };
        };
    };
```

## Documentation/devicetree/bindings/remoteproc/mediatek,mt6895-vcp.yaml
```yaml
# SPDX-License-Identifier: (GPL-2.0-only OR BSD-2-Clause)
%YAML 1.2
---
$id: http://devicetree.org/schemas/remoteproc/mediatek,mt6895-vcp.yaml#
$schema: http://devicetree.org/meta-schemas/core.yaml#

title: MediaTek MT6895 Video Coprocessor

maintainers:
  - Silvia <2824799@users.noreply.github.com>

description: |
  MT6895 VCP runs bootloader-installed firmware in protected memory. The AP
  requests secure reset and release, and supplies communication buffers in
  video IOMMU domain 7. VCP has one RISC-V core with two harts. Its mailbox
  protocol is distinct from the MediaTek Chromebook SCP protocol. SRAM and
  secure code mappings belong to the bootloader; no memory-region property
  authorizes the AP to replace them.

properties:
  compatible:
    const: mediatek,mt6895-vcp

  reg:
    items:
      - description: VCP SRAM
      - description: Configuration and general IPC registers
      - description: Core 0 registers
      - description: Mailbox 0 slots and interrupt registers
      - description: Mailbox 1 slots and interrupt registers
      - description: Mailbox 2 slots and interrupt registers
      - description: Mailbox 3 slots and interrupt registers
      - description: Mailbox 4 slots and interrupt registers

  reg-names:
    items:
      - const: sram
      - const: cfg
      - const: core0
      - const: mbox0
      - const: mbox1
      - const: mbox2
      - const: mbox3
      - const: mbox4

  interrupts:
    maxItems: 6

  interrupt-names:
    items:
      - const: wdt
      - const: mbox0
      - const: mbox1
      - const: mbox2
      - const: mbox3
      - const: mbox4

  clocks:
    items:
      - description: MMUP clock selector
      - description: Main PLL divided by three
      - description: MMUP 26 MHz clock

  clock-names:
    items:
      - const: mmup-sel
      - const: mmup-clk
      - const: mmup-26m

  power-domains:
    maxItems: 1

  iommus:
    maxItems: 1
    description: Video domain 7, pseudo LARB 33, port 2 (0x70422).

  mediatek,smi:
    $ref: /schemas/types.yaml#/definitions/phandle-array
    items:
      - items:
          - description: MDP SMI common
      - items:
          - description: SYSRAM SMI subcommon 4
    description: SMI suppliers required while VCP is powered.

required:
  - compatible
  - reg
  - reg-names
  - interrupts
  - interrupt-names
  - clocks
  - clock-names
  - power-domains
  - iommus
  - mediatek,smi

additionalProperties: false
```

## drivers/gpu/mediatek/Kconfig
```kconfig
# SPDX-License-Identifier: GPL-2.0-only
source "drivers/gpu/mediatek/gpueb/Kconfig"
source "drivers/gpu/mediatek/ged-ge/Kconfig"
```

## drivers/gpu/mediatek/ged-ge/Kconfig
```kconfig
# SPDX-License-Identifier: GPL-2.0-only
config MTK_GED_GE
	bool "MediaTek GED gralloc-extra (GE) region store (/proc/ged)"
	help
	  Exposes /proc/ged, the MediaTek "gralloc-extra" per-buffer property
	  store spoken by the vendor libgralloc_extra.so / libged.so blobs.

	  This is a pure data store (anonymous-inode region array). It has no
	  dependency on the GPU stack and does not interact with DRM, panthor
	  or panfrost. It is only needed so the proprietary camera HAL can
	  query per-buffer gralloc properties on a mainline kernel.

	  If unsure, say N.
```

## drivers/gpu/mediatek/gpueb/Kconfig
```kconfig
# SPDX-License-Identifier: GPL-2.0-only
config MTK_GPUEB
	tristate "MediaTek GPUEB support"
	depends on ARCH_MEDIATEK || COMPILE_TEST
	depends on MTK_MBOX && RPMSG_MTK_MBOX && MTK_IPI
	help
	  Say yes here to enable support for the MediaTek GPU Event Buffer
	  (GPUEB) embedded controller. It is used on some MediaTek SoCs to
	  manage GPU frequency and power state through mailbox IPI.
```

## drivers/interconnect/mediatek/Kconfig
```kconfig
# SPDX-License-Identifier: GPL-2.0-only

config INTERCONNECT_MTK
	bool "MediaTek interconnect drivers"
	depends on ARCH_MEDIATEK || COMPILE_TEST
	help
	  Support for MediaTek's bus interconnect hardware.

config INTERCONNECT_MTK_DVFSRC_EMI
	tristate "MediaTek DVFSRC EMI interconnect driver"
	depends on INTERCONNECT_MTK && MTK_DVFSRC
	help
	  This is a driver for the MediaTek External Memory Interface
	  interconnect on SoCs equipped with the integrated Dynamic
	  Voltage Frequency Scaling Resource Collector (DVFSRC) MCU

config INTERCONNECT_MTK_MT8183
	tristate "MediaTek MT8183 interconnect driver"
	depends on INTERCONNECT_MTK_DVFSRC_EMI
	help
	  This is a driver for the MediaTek bus interconnect on MT8183-based
	  platforms.

config INTERCONNECT_MTK_MT8195
	tristate "MediaTek MT8195 interconnect driver"
	depends on INTERCONNECT_MTK_DVFSRC_EMI
	help
	  This is a driver for the MediaTek bus interconnect on MT8195-based
	  platforms.

config INTERCONNECT_MTK_MT8196
	tristate "MediaTek MT8196 interconnect driver"
	depends on INTERCONNECT_MTK_DVFSRC_EMI
	help
	  This is a driver for the MediaTek bus interconnect on MT8196-based
	  platforms.

config INTERCONNECT_MTK_EMI
	tristate "MediaTek DVFSRC EMI interconnect driver"
	depends on INTERCONNECT_MTK && MTK_DVFSRC && OF
	help
	  This is a driver for the MediaTek External Memory Interface
	  interconnect on DVFSRC-based platforms.  It is registered as a
	  child of the DVFSRC device and is referenced as <&dvfsrc ...>.

config INTERCONNECT_MTK_MMQOS_COMMON
	tristate "MediaTek MMQoS interconnect support"
	select INTERCONNECT_MTK_EXTENSION
	help
	  Support for multimedia QoS in MediaTek's SoCs.  The MMQoS
	  (Multimedia Quality of Service) interconnect driver collects
	  bandwidth requests from multimedia users, such as display, camera,
	  MDP and video codec, and configures the SMI settings dynamically
	  according to the aggregated bandwidth.

config INTERCONNECT_MTK_MMQOS_MT6895
	tristate "MediaTek MT6895 MMQoS interconnect driver"
	depends on INTERCONNECT_MTK && MTK_SMI
	select INTERCONNECT_MTK_MMQOS_COMMON
	help
	  Support MT6895 multimedia QoS.
```

## drivers/media/platform/mediatek/isp/Kconfig
```kconfig
# SPDX-License-Identifier: GPL-2.0-only

config VIDEO_MTK_ISP_71_CAMSYS
	tristate "MediaTek ISP 7.1 camsys driver"
	depends on ARCH_MEDIATEK
	select V4L2_FWNODE
	select VIDEO_V4L2_SUBDEV_API
	select VIDEOBUF2_DMA_CONTIG
	select RPMSG_MTK_CCD
	select MTKCCD_REMOTEPROC
	select MTK_SCP

	default n
	help
		Camsys driver controls 3A (auto-focus, exposure,
		and white balance) with tuning feature and outputs
		the captured image buffers in MediaTek's ISP7 system.

		Choose y if you want to use MediaTek SoCs to create image
		captured application such as video recording and still image
		capturing.
```

## drivers/media/platform/mediatek/isp/isp71/Kconfig
```kconfig
# SPDX-License-Identifier: GPL-2.0-only

config VIDEO_MTK_CAMSV71
	tristate "MediaTek MT6895 CAMSV raw capture"
	depends on V4L_PLATFORM_DRIVERS
	depends on ARCH_MEDIATEK || COMPILE_TEST
	depends on OF && PM && VIDEO_DEV
	depends on (MTK_IOMMU_MT6895 && MTK_SMI && IOMMU_DMA) || COMPILE_TEST
	select MEDIA_CONTROLLER
	select V4L2_ASYNC
	select VIDEO_V4L2_SUBDEV_API
	select VIDEOBUF2_DMA_CONTIG
	help
	  Raw capture DMA engine (CAMSV) of the MediaTek MT6895 camera
	  subsystem. It writes the frames that the SENINF receives from a
	  camera sensor to memory, without ISP processing.

	  To compile this driver as a module, choose M here: the module
	  will be called mtk-camsv71.

config VIDEO_MTK_SENINF71
	tristate "MediaTek MT6895 SENINF camera sensor interface"
	depends on V4L_PLATFORM_DRIVERS
	depends on ARCH_MEDIATEK || COMPILE_TEST
	depends on OF && PM && VIDEO_DEV
	select GENERIC_PHY
	select GENERIC_PHY_MIPI_DPHY
	select MEDIA_CONTROLLER
	select V4L2_FWNODE
	select VIDEO_V4L2_SUBDEV_API
	help
	  MIPI CSI-2 receiver (SENINF) of the MediaTek MT6895 camera
	  subsystem. It routes the data of the camera sensors to the CAMSV
	  engines and provides the media device of the camera pipeline.

	  To compile this driver as a module, choose M here: the module
	  will be called mtk-seninf71.
```

## drivers/memory/mediatek/Kconfig
```kconfig
# SPDX-License-Identifier: GPL-2.0

config MTK_DRAMC
	tristate "MediaTek DRAMC driver"
	depends on ARCH_MEDIATEK
	help
	  Read-only visibility into the MediaTek DRAM controller:
	  fmeter-based data-rate reporting and DDR type / mode-register
	  information.

config MTK6895_DVFSRC_PIN
	tristate "MT6895 DVFSRC manual DDR-OPP pinning"
	depends on ARCH_MEDIATEK
	help
	  Expose the raw DVFSRC SW_REQ dram-level nibble so the DRAM
	  operating point can be pinned from userspace while the full
	  bandwidth-vote stack is not ported yet.
```

## drivers/misc/mediatek/Kconfig
```kconfig
# SPDX-License-Identifier: GPL-2.0
source "drivers/misc/mediatek/cmdq/Kconfig"
source "drivers/misc/mediatek/mminfra/Kconfig"
source "drivers/misc/mediatek/connectivity/Kconfig"
source "drivers/misc/mediatek/scp/Kconfig"
source "drivers/misc/mediatek/sensor/2.0/Kconfig"
source "drivers/misc/mediatek/pwm/Kconfig"
source "drivers/misc/mediatek/irtx/Kconfig"
source "drivers/misc/mediatek/flashlight/Kconfig"
source "drivers/misc/mediatek/monitor_hang/Kconfig"
source "drivers/misc/mediatek/masp/Kconfig"
```

## drivers/misc/mediatek/ccci_core/Kconfig
```kconfig
# SPDX-License-Identifier: GPL-2.0
config MTK_CCCI_CORE
	tristate "MediaTek CCCI Core Driver"
	depends on ARCH_MEDIATEK
	depends on OF
	select MTK_CCCI_UTIL
	help
	  Core driver for MediaTek Cross-Core Communication Interface (CCCI).
	  Provides platform device, memory mapping, and port registration.

	  Say M to build as a module, Y to build into kernel.
```
