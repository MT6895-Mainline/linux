## Documentation/devicetree/bindings/media/i2c/galaxycore,gc02m1.yaml
```yaml
# SPDX-License-Identifier: (GPL-2.0-only OR BSD-2-Clause)
%YAML 1.2
---
$id: http://devicetree.org/schemas/media/i2c/galaxycore,gc02m1.yaml#
$schema: http://devicetree.org/meta-schemas/core.yaml#

title: GalaxyCore GC02M1 2 Mpixel MIPI CSI-2 image sensor

maintainers:
  - Akisaira <akisaira@outlook.com>

description:
  The GalaxyCore GC02M1 is a 1600x1200 raw Bayer image sensor with a
  single-lane MIPI CSI-2 D-PHY transmitter and an I2C compatible control
  interface. The digital core is supplied by an internal regulator.

allOf:
  - $ref: /schemas/media/video-interface-devices.yaml#

properties:
  compatible:
    const: galaxycore,gc02m1

  reg:
    maxItems: 1

  clocks:
    description: External clock (MCLK), 24 MHz.
    maxItems: 1

  avdd-supply:
    description: Analogue supply, 2.8 V.

  dovdd-supply:
    description: Digital I/O supply, 1.8 V.

  reset-gpios:
    description: GPIO connected to the active-low RESETB pin.
    maxItems: 1

  port:
    $ref: /schemas/graph.yaml#/$defs/port-base
    additionalProperties: false

    properties:
      endpoint:
        $ref: /schemas/media/video-interfaces.yaml#
        unevaluatedProperties: false

        properties:
          data-lanes:
            items:
              - const: 1

          link-frequencies: true

        required:
          - data-lanes
          - link-frequencies

    required:
      - endpoint

required:
  - compatible
  - reg
  - clocks
  - avdd-supply
  - dovdd-supply
  - port

unevaluatedProperties: false

examples:
  - |
    #include <dt-bindings/gpio/gpio.h>

    i2c {
        #address-cells = <1>;
        #size-cells = <0>;

        camera@37 {
            compatible = "galaxycore,gc02m1";
            reg = <0x37>;
            avdd-supply = <&vreg_cam_avdd_2p8>;
            clocks = <&cam_mclk>;
            dovdd-supply = <&vreg_cam_dovdd_1p8>;
            orientation = <1>;
            reset-gpios = <&pio 154 GPIO_ACTIVE_LOW>;
            rotation = <270>;

            port {
                endpoint {
                    data-lanes = <1>;
                    link-frequencies = /bits/ 64 <336000000>;
                    remote-endpoint = <&csi_in>;
                };
            };
        };
    };
...
```

## Documentation/devicetree/bindings/media/i2c/samsung,s5k4h7.yaml
```yaml
# SPDX-License-Identifier: (GPL-2.0-only OR BSD-2-Clause)
%YAML 1.2
---
$id: http://devicetree.org/schemas/media/i2c/samsung,s5k4h7.yaml#
$schema: http://devicetree.org/meta-schemas/core.yaml#

title: Samsung S5K4H7 8 Mpixel MIPI CSI-2 image sensor

maintainers:
  - Akisaira <akisaira@outlook.com>

description:
  The Samsung S5K4H7 is a 3264x2448 raw Bayer image sensor with a four-lane
  MIPI CSI-2 D-PHY transmitter and an I2C compatible control interface.

allOf:
  - $ref: /schemas/media/video-interface-devices.yaml#

properties:
  compatible:
    const: samsung,s5k4h7

  reg:
    maxItems: 1

  clocks:
    description: External clock (MCLK), 24 MHz.
    maxItems: 1

  reset-gpios:
    description: GPIO connected to the active-low reset pin.
    maxItems: 1

  vcam-supply:
    description:
      Additional 1.2 V camera module supply, switched by the board and
      enabled before the other supplies.

  vdda-supply:
    description: Analogue supply, 2.8 V.

  vddd-supply:
    description: Digital core supply, 1.2 V.

  vddio-supply:
    description: Digital I/O supply, 1.8 V.

  port:
    $ref: /schemas/graph.yaml#/$defs/port-base
    additionalProperties: false

    properties:
      endpoint:
        $ref: /schemas/media/video-interfaces.yaml#
        unevaluatedProperties: false

        properties:
          data-lanes:
            items:
              - const: 1
              - const: 2
              - const: 3
              - const: 4

          link-frequencies: true

        required:
          - data-lanes
          - link-frequencies

    required:
      - endpoint

required:
  - compatible
  - reg
  - clocks
  - vdda-supply
  - vddd-supply
  - vddio-supply
  - port

unevaluatedProperties: false

examples:
  - |
    #include <dt-bindings/gpio/gpio.h>

    i2c {
        #address-cells = <1>;
        #size-cells = <0>;

        camera@2d {
            compatible = "samsung,s5k4h7";
            reg = <0x2d>;
            clocks = <&cam_mclk>;
            orientation = <1>;
            reset-gpios = <&pio 156 GPIO_ACTIVE_LOW>;
            vcam-supply = <&vreg_cam_1p2>;
            vdda-supply = <&vreg_cam_avdd_2p8>;
            vddd-supply = <&vreg_cam_dvdd_1p2>;
            vddio-supply = <&vreg_cam_dovdd_1p8>;

            port {
                endpoint {
                    data-lanes = <1 2 3 4>;
                    link-frequencies = /bits/ 64 <330000000>;
                    remote-endpoint = <&csi_in>;
                };
            };
        };
    };
...
```

## Documentation/devicetree/bindings/media/i2c/sony,imx582.yaml
```yaml
# SPDX-License-Identifier: (GPL-2.0-only OR BSD-2-Clause)
%YAML 1.2
---
$id: http://devicetree.org/schemas/media/i2c/sony,imx582.yaml#
$schema: http://devicetree.org/meta-schemas/core.yaml#

title: Sony IMX582 48 Mpixel MIPI CSI-2 image sensor

maintainers:
  - Akisaira <akisaira@outlook.com>

description:
  The Sony IMX582 is an 8000x6000 quad Bayer CMOS image sensor with a
  four-lane MIPI CSI-2 D-PHY transmitter and an I2C compatible control
  interface. Its binned readout modes output a standard Bayer pattern.

allOf:
  - $ref: /schemas/media/video-interface-devices.yaml#

properties:
  compatible:
    const: sony,imx582

  reg:
    maxItems: 1

  clocks:
    description: External clock (INCK), 24 MHz.
    maxItems: 1

  afvdd-supply:
    description:
      Autofocus actuator supply of the camera module, 2.9 V. The actuator
      shares the control bus with the sensor, so the supply is on whenever
      the sensor is powered.

  avdd-supply:
    description: Analogue supply, 2.9 V.

  avdd2-supply:
    description: Second analogue supply, 1.8 V.

  dovdd-supply:
    description: Digital I/O supply, 1.8 V.

  dvdd-supply:
    description: Digital core supply.

  vcam-supply:
    description: Camera module supply, 1.2 V.

  reset-gpios:
    description: GPIO connected to the active-low XCLR pin.
    maxItems: 1

  port:
    $ref: /schemas/graph.yaml#/$defs/port-base
    additionalProperties: false

    properties:
      endpoint:
        $ref: /schemas/media/video-interfaces.yaml#
        unevaluatedProperties: false

        properties:
          data-lanes:
            items:
              - const: 1
              - const: 2
              - const: 3
              - const: 4

          link-frequencies: true

        required:
          - data-lanes
          - link-frequencies

    required:
      - endpoint

required:
  - compatible
  - reg
  - clocks
  - avdd-supply
  - avdd2-supply
  - dovdd-supply
  - dvdd-supply
  - port

unevaluatedProperties: false

examples:
  - |
    #include <dt-bindings/gpio/gpio.h>

    i2c {
        #address-cells = <1>;
        #size-cells = <0>;

        camera@10 {
            compatible = "sony,imx582";
            reg = <0x10>;
            afvdd-supply = <&vreg_cam_afvdd_2p9>;
            avdd2-supply = <&vreg_cam_avdd2_1p8>;
            avdd-supply = <&vreg_cam_avdd_2p9>;
            clocks = <&cam_mclk>;
            dovdd-supply = <&vreg_cam_dovdd_1p8>;
            dvdd-supply = <&vreg_cam_dvdd>;
            orientation = <1>;
            reset-gpios = <&pio 155 GPIO_ACTIVE_LOW>;
            vcam-supply = <&vreg_cam_vcam_1p2>;

            port {
                endpoint {
                    data-lanes = <1 2 3 4>;
                    link-frequencies = /bits/ 64 <685000000>;
                    remote-endpoint = <&csi_in>;
                };
            };
        };
    };
...
```

## Documentation/devicetree/bindings/media/i2c/sony,imx596.yaml
```yaml
# SPDX-License-Identifier: (GPL-2.0-only OR BSD-2-Clause)
%YAML 1.2
---
$id: http://devicetree.org/schemas/media/i2c/sony,imx596.yaml#
$schema: http://devicetree.org/meta-schemas/core.yaml#

title: Sony IMX596 20 Mpixel MIPI CSI-2 image sensor

maintainers:
  - Akisaira <akisaira@outlook.com>

description:
  The Sony IMX596 is a 20 Mpixel raw image sensor with a quad Bayer colour
  filter array, a four-lane MIPI CSI-2 D-PHY transmitter and an I2C
  compatible control interface.

allOf:
  - $ref: /schemas/media/video-interface-devices.yaml#

properties:
  compatible:
    const: sony,imx596

  reg:
    maxItems: 1

  clocks:
    description: External clock (INCK), 24 MHz.
    maxItems: 1

  avdd-supply:
    description: Analogue supply, 2.9 V.

  dovdd-supply:
    description: Digital I/O supply, 1.8 V.

  dvdd-supply:
    description: Digital core supply, 1.1 V.

  vcam-supply:
    description:
      Additional 1.2 V camera module supply that some boards switch on
      before the other supplies. Its use inside the module is not
      documented.

  reset-gpios:
    description: GPIO connected to the active-low XCLR pin.
    maxItems: 1

  port:
    $ref: /schemas/graph.yaml#/$defs/port-base
    additionalProperties: false

    properties:
      endpoint:
        $ref: /schemas/media/video-interfaces.yaml#
        unevaluatedProperties: false

        properties:
          data-lanes:
            items:
              - const: 1
              - const: 2
              - const: 3
              - const: 4

          link-frequencies: true

        required:
          - data-lanes
          - link-frequencies

    required:
      - endpoint

required:
  - compatible
  - reg
  - clocks
  - avdd-supply
  - dovdd-supply
  - dvdd-supply
  - port

unevaluatedProperties: false

examples:
  - |
    #include <dt-bindings/gpio/gpio.h>

    i2c {
        #address-cells = <1>;
        #size-cells = <0>;

        camera@10 {
            compatible = "sony,imx596";
            reg = <0x10>;
            avdd-supply = <&vreg_cam_avdd_2p9>;
            clocks = <&cam_mclk>;
            dovdd-supply = <&vreg_cam_dovdd_1p8>;
            dvdd-supply = <&vreg_cam_dvdd_1p1>;
            orientation = <0>;
            reset-gpios = <&pio 153 GPIO_ACTIVE_LOW>;
            vcam-supply = <&vreg_cam_vcam_1p2>;

            port {
                endpoint {
                    data-lanes = <1 2 3 4>;
                    link-frequencies = /bits/ 64 <678000000>;
                    remote-endpoint = <&csi_in>;
                };
            };
        };
    };
...
```

## Documentation/devicetree/bindings/media/mediatek,mt6895-camsv.yaml
```yaml
# SPDX-License-Identifier: (GPL-2.0-only OR BSD-2-Clause)
%YAML 1.2
---
$id: http://devicetree.org/schemas/media/mediatek,mt6895-camsv.yaml#
$schema: http://devicetree.org/meta-schemas/core.yaml#

title: MediaTek MT6895 camera raw capture engine (CAMSV)

maintainers:
  - Akisaira <akisaira@outlook.com>

description:
  CAMSV is the raw capture engine of the MediaTek ISP 7.1 camera subsystem. An
  instance receives the pixel stream of one camera multiplexer (CAM_MUX)
  output of the SENINF and writes it to memory through its IMGO DMA port,
  without ISP processing. The graph connection of its port describes the
  SENINF output that feeds the instance; the multiplexer and the instance are
  identified by the graph and the register address, not by index properties.

properties:
  compatible:
    const: mediatek,mt6895-camsv

  reg:
    items:
      - description: CAMSV registers
      - description: Inner CAMSV registers, a read-only view of the values
          latched at the start of the current frame

  reg-names:
    items:
      - const: base
      - const: inner

  interrupts:
    maxItems: 1

  clocks:
    items:
      - description: CAM to MM0 GALS bridge
      - description: CAM to MM1 GALS bridge
      - description: CAM to SYS GALS bridge
      - description: CAM main gate
      - description: Camera timing generator gate
      - description: SMI LARB gate of the IMGO port
      - description: CAMSV group (GCAMSV) gate
      - description: CAMSV top gate
      - description: Top-level CAM clock
      - description: Top-level camera timing generator clock
      - description: Top-level CAMTM clock
      - description: CAMSV command queue gate

  clock-names:
    items:
      - const: cam2mm0
      - const: cam2mm1
      - const: cam2sys
      - const: cam
      - const: camtg
      - const: larb
      - const: gcamsv
      - const: camsv-top
      - const: top-cam
      - const: top-camtg
      - const: top-camtm
      - const: camsv-cq

  power-domains:
    minItems: 1
    items:
      - description: CAM_MAIN power domain
      - description: ISP_MAIN power domain

  power-domain-names:
    minItems: 1
    items:
      - const: cam
      - const: isp

  iommus:
    maxItems: 1
    description: IMGO write port on its SMI local arbiter (LARB)

  port:
    $ref: /schemas/graph.yaml#/properties/port
    description: Input from the SENINF camera multiplexer output that feeds
      this instance

required:
  - compatible
  - reg
  - reg-names
  - interrupts
  - clocks
  - clock-names
  - power-domains
  - power-domain-names
  - iommus
  - port

additionalProperties: false

examples:
  - |
    #include <dt-bindings/clock/mt6895-clk.h>
    #include <dt-bindings/interrupt-controller/arm-gic.h>
    #include <dt-bindings/interrupt-controller/irq.h>
    #include <dt-bindings/memory/mtk-memory-port.h>
    #include <dt-bindings/power/mt6895-power.h>

    camsv@1a110000 {
        compatible = "mediatek,mt6895-camsv";
        reg = <0x1a110000 0x1000>, <0x1a118000 0x1000>;
        reg-names = "base", "inner";
        interrupts = <GIC_SPI 445 IRQ_TYPE_LEVEL_HIGH>;
        clocks = <&cam_main_r1a_clk CLK_CAM_MAIN_CAM2MM0_GALS_CON>,
                 <&cam_main_r1a_clk CLK_CAM_MAIN_CAM2MM1_GALS_CON>,
                 <&cam_main_r1a_clk CLK_CAM_MAIN_CAM2SYS_GALS_CON>,
                 <&cam_main_r1a_clk CLK_CAM_MAIN_CAM_CON>,
                 <&cam_main_r1a_clk CLK_CAM_MAIN_CAMTG_CON>,
                 <&cam_main_r1a_clk CLK_CAM_MAIN_LARB13_CON>,
                 <&cam_main_r1a_clk CLK_CAM_MAIN_GCAMSVA_CON>,
                 <&cam_main_r1a_clk CLK_CAM_MAIN_CAMSV_TOP_CON>,
                 <&topckgen CLK_TOP_CAM_SEL>,
                 <&topckgen CLK_TOP_CAMTG_SEL>,
                 <&topckgen CLK_TOP_CAMTM_SEL>,
                 <&cam_main_r1a_clk CLK_CAM_MAIN_CAMSV_CQ_A_CON>;
        clock-names = "cam2mm0", "cam2mm1", "cam2sys", "cam", "camtg",
                      "larb", "gcamsv", "camsv-top", "top-cam",
                      "top-camtg", "top-camtm", "camsv-cq";
        power-domains = <&spm MT6895_POWER_DOMAIN_CAM_MAIN>,
                        <&spm MT6895_POWER_DOMAIN_ISP_MAIN>;
        power-domain-names = "cam", "isp";
        iommus = <&disp_iommu MTK_M4U_ID(13, 2)>;

        port {
            endpoint {
                remote-endpoint = <&seninf_cammux3_out>;
            };
        };
    };
...
```
